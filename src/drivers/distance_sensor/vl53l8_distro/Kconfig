## src/drivers/distance_sensor/vl53l8_distro/Kconfig
```kconfig
menuconfig DRIVERS_DISTANCE_SENSOR_VL53L8_DISTRO
	bool "vl53l8_distro"
	default n
	---help---
		Enable support for vl53l8_distro
```

## src/drivers/optical_flow/pat9136/Kconfig
```kconfig
menuconfig DRIVERS_OPTICAL_FLOW_PAT9136
	bool "pat9136"
	default n
	---help---
		Enable support for PixArt PAT9136
```

## src/modules/shaft_kf/Kconfig
```kconfig
menuconfig MODULES_SHAFT_KF
	bool "shaft_kf"
	default n
	---help---
		Enable support for ShaftKF
```
